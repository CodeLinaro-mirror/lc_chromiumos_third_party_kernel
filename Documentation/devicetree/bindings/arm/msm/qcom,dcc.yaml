## virt/lib/Kconfig
```kconfig
# SPDX-License-Identifier: GPL-2.0-only
config IRQ_BYPASS_MANAGER
	tristate

config PLAT_IRQ_FORWARD
	tristate "Enable forwarding arbitrary platform IRQs to guest in KVM"
```
