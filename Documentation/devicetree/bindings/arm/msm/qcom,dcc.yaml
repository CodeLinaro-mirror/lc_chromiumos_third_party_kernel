## Documentation/devicetree/bindings/arm/msm/qcom,dcc.yaml
```yaml
#SPDX-License-Identifier: GPL-2.0-only
#Copyright (c) 2021, The Linux Foundation. All rights reserved.

%YAML 1.2
---
$id: http://devicetree.org/schemas/arm/msm/qcom,dcc.yaml#
$schema: http://devicetree.org/meta-schemas/core.yaml#

title: Data Capture and Compare

maintainers:
  - Souradeep Chowdhury <schowdhu@codeaurora.org>

description: |
    DCC (Data Capture and Compare) is a DMA engine which is used to save
    configuration data or system memory contents during catastrophic failure
    or SW trigger.DCC is used to capture and store data for debugging purpose


properties:
  compatible:
    items:
    - enum:
      - qcom,sm8150-dcc
      - qcom,sc7280-dcc
    - const: qcom,dcc

  reg:
    items:
      - description: DCC base register region
      - description: DCC RAM base register region

  reg-names:
    items:
      - const: dcc-base
      - const: dcc-ram-base

required:
  - compatible
  - reg
  - reg-names

additionalProperties: false

examples:
  - |
    dcc@010a2000{
                compatible = "qcom,sm8150-dcc";
                reg = <0 0x010a2000 0  0x1000>,
                      <0 0x010ae000 0  0x2000>;
                reg-names = "dcc-base", "dcc-ram-base";
    };
```

## Documentation/devicetree/bindings/clock/qcom,rpmh.txt
```
Qualcomm Technologies, Inc. RPMh Clocks
-------------------------------------------------------

Resource Power Manager Hardened (RPMH) manages shared resources on
some Qualcomm Technologies Inc. SoCs. It accepts clock requests from
other hardware subsystems via RSC to control clocks.

Required properties :
- compatible : shall contain "qcom,rpmh-clk-sdm845"

- #clock-cells : must contain 1

Example :
        &apps_rsc {
                clock_rpmh: qcom,rpmhclk {
                        compatible = "qcom,rpmh-clk-sdm845";
                        #clock-cells = <1>;
                };
        };
```

## Documentation/devicetree/bindings/clock/qcom,videocc.txt
```
Qualcomm Video Clock & Reset Controller Binding
-----------------------------------------------

Required properties :
- compatible : shall contain "qcom,videocc-sdm845"
- reg : shall contain base register location and length
- reg-names: names of registers listed in the same order as in
	     the reg property.
- #clock-cells : shall contain 1
- #reset-cells : shall contain 1
- #power-domain-cells : shall contain 1

Example:
	clock_videocc: qcom,videocc@ab00000 {
		compatible = "qcom,videocc-sdm845";
		reg = <0xab00000 0x10000>;
		reg-names = "cc_base";
		#clock-cells = <1>;
		#reset-cells = <1>;
		#power-domain-cells = <1>;
	};
```

## Documentation/devicetree/bindings/edac/qcom-kryo-edac.yaml
```yaml
# SPDX-License-Identifier: (GPL-2.0-only OR BSD-2-Clause)
%YAML 1.2
---
$id: http://devicetree.org/schemas/edac/qcom-kryo-edac.yaml#
$schema: http://devicetree.org/meta-schemas/core.yaml#

title: Kryo Error Detection and Correction(EDAC)

maintainers:
  - Sai Prakash Ranjan <saiprakash.ranjan@codeaurora.org>

description: |
  Kryo EDAC is defined to describe on-chip error detection and correction
  for the Kryo CPU cores which implement RAS extensions. It will report
  all Single Bit Errors and Double Bit Errors found in L1/L2 caches in
  in two registers ERXSTATUS_EL1 and ERXMISC0_EL1. L3-SCU cache errors
  are reported in ERR1STATUS and ERR1MISC0 registers.
    ERXSTATUS_EL1 - Selected Error Record Primary Status Register, EL1
    ERXMISC0_EL1 - Selected Error Record Miscellaneous Register 0, EL1
    ERR1STATUS - Error Record Primary Status Register
    ERR1MISC0 - Error Record Miscellaneous Register 0
  Current implementation of Kryo ECC(Error Correcting Code) mechanism is
  based on interrupts.

properties:
  compatible:
    enum:
      - qcom,kryo-edac

  interrupts:
    minItems: 1
    maxItems: 4
    items:
      - description: l1-l2 cache faultirq interrupt
      - description: l1-l2 cache errirq interrupt
      - description: l3-scu cache errirq interrupt
      - description: l3-scu cache faultirq interrupt

  interrupt-names:
    minItems: 1
    maxItems: 4
    items:
      - const: l1-l2-faultirq
      - const: l1-l2-errirq
      - const: l3-scu-errirq
      - const: l3-scu-faultirq

required:
  - compatible
  - interrupts
  - interrupt-names

examples:
  - |
    #include <dt-bindings/interrupt-controller/arm-gic.h>

    kryo_edac {
      compatible = "qcom,kryo-edac";
      interrupts = <GIC_PPI 6 IRQ_TYPE_LEVEL_HIGH>,
                   <GIC_PPI 7 IRQ_TYPE_LEVEL_HIGH>,
                   <GIC_SPI 34 IRQ_TYPE_LEVEL_HIGH>,
                   <GIC_SPI 35 IRQ_TYPE_LEVEL_HIGH>;
      interrupt-names = "l1-l2-faultirq",
                        "l1-l2-errirq",
                        "l3-scu-errirq",
                        "l3-scu-faultirq";
    };
```

## Documentation/devicetree/bindings/sound/qcom,lpass-cpu.txt
```
* Qualcomm Technologies LPASS CPU DAI binding

Low-Power Audio SubSystem (LPASS) consist of MI2S interfaces for audio data
transfer on external codec. LPASS cpu driver is a common code to configure
MI2S related CPU dai's across different version of LPASS architecture.

- compatible:
	Usage: required
	Value type: <stringlist>
	Definition: compatible string corresponds to lpass variants driver
		    must be "qcom, lpass-cpu-sc7180" for sc7180 lpass
		    must be "qcom,apq8016-lpass-cpu" for apq8016 lpass
- reg:
	Usage: required
	Value type: <prop-encoded-array>
	Definition: must specify the base address and size of the LPAIF CORE
		    region of lpass variant.
- reg-names:
	Usage: required
	Value type: <stringlist>
	Definition: must be "lpass-lpaif"

- iommus:
        Usage: required for "qcom, lpass-cpu-sc7180" compatible string
        Value type: <prop-encoded-array>
        Definition: sid mask for lpaif memory region to apps_smmu
                    must be <&apps_smmu 0x1020 0>

- power-domains:
	Usage: required for "qcom, lpass-cpu-sc7180" compatible string
	Value type: <phandle>
	Definition: reference to power-domains
		    must be <&lpass_hm LPASS_CORE_HM_GDSCR>

- clocks:
        Usage: required
	Value type: <phandle>
	Definition: reference to the clocks that match clock-names

- clock-names:
	Usage: required
	Value type: <stringlist>
	Definition: The clocks needed depend on the compatible string:
	qcom,lpass-cpu-apq8016:
		must be "ahbix-clk", "mi2s-osr-clk", "mi2s-bit-clk0",
		mi2s-bit-clk1", "mi2s-bit-clk2", "mi2s-bit-clk3",
		"pcnoc-mport-clk", "pcnoc-sway-clk"
	qcom, lpass-cpu-sc7180:
		must be "noc", "audio-core", "mclk0", "sysnoc_mport",
		"pri_ibit", "sec_ibit"

- #sound-dai-cells
	Usage: required
	Value type: <u32>
	Definition: Must be 1

- interrupts:
	Usage: required
	Value type: <prop-encoded-array>
	Definition: reference to the interrupts that match interrupt-names

- interrupt-names:
	Usage: required
	Value type: <stringlist>
	Definition: must be "lpass-irq-lpaif"

- qcom,adsp:
        Usage: optional
        Value type: <phandle>
	Definition: Phandle for the audio DSP node

= MI2S DAIs (Digial Audio Interface)
"dais" child node of the lpass node. It represents mi2s dais, each mi2s dai is
subnode of "dais" representing board specific dai setup & required dai clocks.
"dais" node should have following properties.

- id:
	Usage: required for mi2s interface
	Value type: <u32>
	Definition: Must be dai id defined in lpass bindings like MI2S_PRIMARY

- qcom,bitclk-name:
	Usage: required for mi2s interface
	Value type: <stringlist>
	Definition: bitclk name corresponds to MI2S of lpass version

- qcom,mclk-name:
        Usage: optional for mi2s interface
        Value type: <stringlist>
        Definition: external mclk name corresponds to MI2S of lpass version

- qcom,osrclk-name:
        Usage: optional for mi2s interface
        Value type: <stringlist>
        Definition: osrclk name corresponds to MI2S of lpass version

- qcom,spkmode-mask:
        Usage: optional for mi2s interface
        Value type: <u32>
        Definition: board specific property to change default spkmode mask
                    of MI2S dai based on dataline connection on board.

- qcom,micmode-mask:
        Usage: optional for mi2s interface
        Value type: <u32>
        Definition: board specific property to change default micmode mask
                    of MI2S dai based on dataline connection on board.

- qcom,loopback-mask:
        Usage: optional for mi2s interface
        Value type: <u32>
        Definition: board specific property to change default loopback mask
                    of MI2S dai as per requirement.

- qcom,wssrc-mask:
        Usage: optional for mi2s interface
        Value type: <u32>
        Definition: board specific property to change default wssrc mask
                    of MI2S dai based as per requirement.

Example:

lpass_cpu: lpass {
	compatible = "qcom, lpass-cpu-sc7180";

	reg = <0 0x62F00000 0 0x29000>;
	reg-names = "lpass-lpaif";

	iommus = <&apps_smmu 0x1020 0>;

	power-domains = <&lpass_hm LPASS_CORE_HM_GDSCR>;

	clocks = <&gcc GCC_LPASS_CFG_NOC_SWAY_CLK>,
		 <&lpasscorecc LPASS_AUDIO_CORE_CORE_CLK>,
		 <&lpasscorecc LPASS_AUDIO_CORE_EXT_MCLK0_CLK>,
		 <&lpasscorecc LPASS_AUDIO_CORE_SYSNOC_MPORT_CORE_CLK>,
		 <&lpasscorecc LPASS_AUDIO_CORE_LPAIF_PRI_IBIT_CLK>,
		 <&lpasscorecc LPASS_AUDIO_CORE_LPAIF_SEC_IBIT_CLK>;

	clock-names = "noc", "audio-core", "mclk0", "sysnoc_mport",
		      "pri_ibit", "sec_ibit";

	#sound-dai-cells = <1>;

	interrupts = <0 160 IRQ_TYPE_LEVEL_HIGH>;
	interrupt-names = "lpass-irq-lpaif";

	prim-mi2s@0 {
		id = <MI2S_PRIMARY>;
		qcom,bitclk-name = "pri_ibit";
		qcom,mclk-name = "mclk0";
	};

	sec-mi2s@1 {
		id = <MI2S_SECONDARY>;
		qcom,bitclk-name = "sec_ibit";
	};
};
```

## drivers/media/platform/msm/Kconfig
```kconfig
#
# Qualcomm camera configuration
#

menuconfig SPECTRA_CAMERA
	bool "Qualcomm Technologies, Inc. Spectra Camera"
	depends on (ARCH_QCOM)
	depends on INTERCONNECT || !INTERCONNECT
	depends on (MEDIA_SUPPORT && MEDIA_CONTROLLER && V4L_PLATFORM_DRIVERS)
	select SC_CAMCC_7180
	help
	  Say Y here to enable selecting the video adapters for
	  Qualcomm Technologies, Inc. Spectra camera and video capture.
	  Enabling this adds support for the camera driver stack including sensor,
	  IFE and postprocessing drivers.

if SPECTRA_CAMERA

config QTI_CAMERA_SYNC
        bool "Qualcomm camera SYNC driver"
	default y
	depends on (VIDEO_DEV && VIDEO_V4L2)
        help
          Support for camera drivers synchronization

          To compile this driver as a module, choose M here

config QTI_CAMERA_SMMU
        bool "Qualcomm System Memory Management Unit (SMMU)"
	default y
	depends on (IOMMU_DMA && QCOM_IOMMU)
        help
          Support for memory pools and context banks

          To compile this driver as a module, choose M here

config QTI_CAMERA_CRM
        bool "Qualcomm Camera Request Manager (CRM)"
	default y
	depends on (QTI_CAMERA_SYNC && QTI_CAMERA_SMMU)
	depends on (VIDEO_DEV && VIDEO_V4L2)
	select VIDEOBUF2_DMA_SG
        help
          Support for camera drivers memory requests

          To compile this driver as a module, choose M here

config QTI_ISP
        bool "Qualcomm ISP drivers"
	depends on (QTI_CAMERA_SYNC && QTI_CAMERA_SMMU && QTI_CAMERA_CRM)
	default y
        help
	  Support for the ISP engine

	  To compile this driver as a module, choose M here

if QTI_ISP
	config QTI_MIPI_PHY
		bool "Qualcomm MIPI C-PHY driver"
		default y
		depends on (QTI_ISP)
		help
		Support for MIPI Combo CSI physical interfaces

		To compile this driver as a module, choose M here

	config QTI_PPI
		bool "Qualcomm PPI driver"
		depends on (QTI_ISP)
		help
		Support for the PPI interfaces

		To compile this driver as a module, choose M here

	config QTI_CSID
		bool "Qualcomm CSIDx driver"
		default y
		depends on (QTI_ISP)
		help
		Support for the CSIDx engines

		To compile this driver as a module, choose M here

	config QTI_VFE
		bool "Qualcomm VFEx driver"
		default y
		depends on (QTI_ISP)
		help
		Support for the VFEx engines

		To compile this driver as a module, choose M here

	config QTI_VFE_LITE
		bool "Qualcomm Lite VFEx driver"
		default y
		depends on (QTI_ISP)
		help
		Support for the Lite IFEx engines

		To compile this driver as a module, choose M here
endif

config QTI_ICP_A5
        bool "Qualcomm ICP/A5 driver"
	depends on (QTI_CAMERA_SYNC && QTI_CAMERA_SMMU && QTI_CAMERA_CRM)
	default y
        help
          Support for the ICP/A5 engine

          To compile this driver as a module, choose M here

if QTI_ICP_A5
	config QTI_IPE
		bool "Qualcomm IPE driver"
		default y
		depends on (QTI_ICP_A5)
		help
		Support for the IPE engines

		To compile this driver as a module, choose M here

	config QTI_BPS
		bool "Qualcomm BPS driver"
		default y
		depends on (QTI_ICP_A5)
		help
		Support for the BPS engine

		To compile this driver as a module, choose M here

endif

config QTI_CPAS
        bool "Qualcomm CPAS driver"
	default y
	depends on (QTI_CAMERA_SYNC && QTI_CAMERA_SMMU && QTI_CAMERA_CRM)
	select INTERCONNECT
        help
          Support for CDMx engines SW interface

          To compile this driver as a module, choose M here

if QTI_CPAS
	config QTI_CDM
		bool "Qualcomm CDMx driver"
		default y
		depends on (QTI_CPAS)
		help
		Support for the CDMx engine

		To compile this driver as a module, choose M here
endif

config QTI_JPEG
        bool "Qualcomm JPEG driver"
	default n
	depends on (QTI_CAMERA_SYNC && QTI_CAMERA_SMMU && QTI_CAMERA_CRM)
        help
          Support for the JPEG engine

          To compile this driver as a module, choose M here

config QTI_FD
        bool "Qualcomm FD driver"
	default n
	depends on (QTI_CAMERA_SYNC && QTI_CAMERA_SMMU && QTI_CAMERA_CRM)
        help
          Support for the FD engine

          To compile this driver as a module, choose M here

config QTI_LRME
        bool "Qualcomm LRME driver"
	default n
	depends on (QTI_CAMERA_SYNC && QTI_CAMERA_SMMU && QTI_CAMERA_CRM)
        help
          Support for the LRME engine

          To compile this driver as a module, choose M here

config QTI_SENSORS
        bool "Qualcomm sensor drivers"
	default y
	depends on (QTI_CAMERA_SYNC && QTI_CAMERA_SMMU && QTI_CAMERA_CRM)
        help
          Support for the Sensors and Actuator etc

          To compile this driver as a module, choose M here

if QTI_SENSORS
	config QTI_CCI
		bool "Qualcomm CCI driver"
		default y
		depends on (I2C && I2C_QUP)
		help
		  Support for the synchronous QUP based I2C interface

		  To compile this driver as a module, choose M here

	config QTI_I2C
		bool "Qualcomm I2C driver"
		default y
		depends on (I2C && I2C_QCOM_GENI)
		help
		  Support for the synchronous GENI based I2C interface

		  To compile this driver as a module, choose M here

	config QTI_SPI
		bool "Qualcomm SPI_GENI driver"
		default n
		depends on (SPI && (SPI_QCOM_GENI || SPI_QCOM_QSPI))
		help
		  Support for the GENI based Serial Peripheral Interface

		  To compile this driver as a module, choose M here
endif

endif
```

## drivers/platform/msm/Kconfig
```kconfig
menu "Qualcomm technologies inc. MSM specific device drivers"
	depends on ARCH_QCOM

config QCOM_GENI_SE
	tristate "QCOM GENI Serial Engine Driver"
	help
	  This module is used to interact with GENI based Serial Engines on
	  Qualcomm Technologies, Inc. Universal Peripheral(QUPv3). This
	  module is used to configure and read the configuration from the
	  Serial Engines.

config QPNP_REVID
	tristate "QPNP Revision ID Peripheral"
	depends on SPMI
	help
	  Say 'y' here to include support for the Qualcomm Technologies, Inc.
	  QPNP REVID peripheral. REVID prints out the PMIC type and revision
	  numbers in the kernel log along with the PMIC option status. The PMIC
	  type is mapped to a QTI chip part number and logged as well.

endmenu
```
